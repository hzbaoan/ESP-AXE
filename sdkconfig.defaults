## sdkconfig.defaults
```kconfig
CONFIG_PARTITION_TABLE_CUSTOM=y
CONFIG_PARTITION_TABLE_CUSTOM_FILENAME="partitions.csv"
CONFIG_PARTITION_TABLE_FILENAME="partitions.csv"
CONFIG_PARTITION_TABLE_OFFSET=0x8000
CONFIG_PARTITION_TABLE_MD5=y
CONFIG_ESPTOOLPY_FLASHSIZE_16MB=y
CONFIG_ESPTOOLPY_FLASHSIZE="16MB"
CONFIG_HTTPD_WS_SUPPORT=y
CONFIG_SPIFFS_OBJ_NAME_LEN=64
CONFIG_HTTPD_MAX_URI_LEN=2048
CONFIG_ESP32S3_DEFAULT_CPU_FREQ_240=y
CONFIG_ESP_WIFI_11KV_SUPPORT=y
CONFIG_LV_CONF_SKIP=n
CONFIG_BT_ENABLED=n
CONFIG_LWIP_MAX_SOCKETS=16
CONFIG_SPIRAM=y
CONFIG_SPIRAM_MODE_OCT=y
CONFIG_SPIRAM_SPEED_80M=y
CONFIG_SPIRAM_IGNORE_NOTFOUND=y
CONFIG_LOG_COLORS=y

# ========== 黄金优化配套配置 ==========

# 1. 提升编译器优化级别为 Performance (-O2)
# 默认是 -Os (偏向减小固件体积)。改为性能优先，极大地提升 SHA256 和循环位运算的速度！
CONFIG_COMPILER_OPTIMIZATION_PERF=y

# 2. FreeRTOS 时钟 Tick 提升至 1000Hz (1ms精度)
# 默认是 100Hz (10ms精度)。我们的 ASIC_task 使用了毫秒级的信号量等待，必须开启 1000Hz 才能做到微秒级的不卡顿调度！
CONFIG_FREERTOS_HZ=1000

# 3. 强制开启 mbedTLS 的硬件 SHA256 加速
CONFIG_MBEDTLS_HARDWARE_SHA=y

# 4. 开启 OTA 防变砖回滚机制 (安全兜底)
# 如果刷入的固件发生连续重启崩溃，系统会自动切回上一个正常工作的固件分区，永远不会变砖！
CONFIG_BOOTLOADER_APP_ROLLBACK_ENABLE=y

# 5. 增大主任务栈大小
# 因为我们将大量 malloc 改为了栈内存 (Stack) 分配，适度增大主任务栈容量防止栈溢出
CONFIG_ESP_MAIN_TASK_STACK_SIZE=8192
```
